## lib/sf/transport/Kconfig
```kconfig
config SFLIB_TRANSPORT
	bool "Transport component of the Security Framework"
	default n
	depends on SFLIB_CORE
	help
		This select the library for communication between kernel and user-space
		components.

choice
	prompt "Default transport mechanism"
	depends on SFLIB_TRANSPORT

	config SFLIB_TRANSPORT_NETLINK
		bool "Netlink based transport"
		help
			Transport based on netlink sockets

	config SFLIB_TRANSPORT_SHMEM
		bool "Shared memory based transport"
		help
			Transport based on shared memory and SF allocator.
			Temporary unsupported.

	config SFLIB_TRANSPORT_SYSFS
		bool "SysFS based transport"
		help
			Transport based on SysFS mechanisms.
			Temporary unsupported.

endchoice
```

## security/sfd/Kconfig
```kconfig
#
# Security Filter Driver
#

menu "Security Filter Driver (Smart Security)"

config SECURITY_SFD
	bool "Security Filter Driver support"
	default n
	select SFLIB
	help
		This selects SFD, which filter system events. SFD working
		in two modes:
			1. Enforce
			2. Permissive

		TODO: To add more information later.

		If you unsure how to answer this question, answer N.

choice
	prompt "Working mode"
	depends on SECURITY_SFD
	help
		Select the Security Filter Driver working mode.

	config SECURITY_SFD_MODE_PERMISSIVE
		bool "Permissive mode"
		help
			Do not perform any blocking for the system routines.

	config SECURITY_SFD_MODE_ENFORCE
		bool "Enforce mode"
		help
			Blocks system routines that can not meet Security Filter Driver policy.

endchoice

choice
	prompt "Platform policy"
	depends on SECURITY_SFD
	help
		Select the platform configuration. Current version suport Tizen, Orsay, x86 generic kernel.

	config SECURITY_SFD_PLATFORM_TIZEN
		bool "Tizen platform Security Framework policy"
		help
			This selects default configuration based on Tizen platform which will be used by
			Security Framework.
			Tizen platform policy:
				1. /opt
				2. /var
				3. /mtd_rwarea

	config SECURITY_SFD_PLATFORM_ORSAY
		bool "Orsay platform Security Framework policy"
		help
			This selects default configuration based on Orsay platform which will be used by
			Security Framework.
			Orsay platform policy:
				1. /mtd_uniro
				2. /mtd_exe
				3. /mtd_rwarea
				4. /mtd_drmregion_a
				5. /mtd_drmregion_b
				6. /sys/kernel/debug
				7. /mtd_rocommon
				8. /mtd_unirw
				9. /tmp
				10. /dtv

endchoice

choice
	prompt "Working level"
	depends on SECURITY_SFD
	help
		Select the working level for Security Filter Driver components.
		The following work levels are possible:
			1. Debug level
			2. Release mode

	config SECURITY_SFD_LEVEL_DEBUG
		bool "Debug level"
		help
			This selects debug working level for Security Filter Driver and
			all components.

	config SECURITY_SFD_LEVEL_RELEASE
		bool "Release level"
		help
			This selects release working level for Security Filter Driver and
			all components.

endchoice

source security/sfd/dispatcher/Kconfig
source security/sfd/notifier/Kconfig
source security/sfd/uep/Kconfig

endmenu
```

## security/sfd/dispatcher/Kconfig
```kconfig
#
# Dispatcher module of the SFD
#

config SECURITY_SFD_DISPATCHER
	bool "Dispatcher"
	depends on SECURITY_SFD
	default y
	help
		This module is the major component of SFD. Dispathcer allocates kernel resources to other
		SFD components. Current version of dispatcher module MUST be bult-in. Dispatcher provide
		API for other SFD related modules such UEP, Notifier, etc. Dispatcher creates communication
		BUS with the user-space based on netlink multicast protocol.

		If you unsure how to answer this question, answer Y.

config SECURITY_SFD_DISPATHCER_EXEC
	bool "Process EXEC system call"
	depends on SECURITY_SFD_DISPATCHER
	default n
	help
		This option enable exec (sys_exec, sys_execve, sys_execl, etc.) system call processing
		routine for Security Framework modules. This is done by adding a call into the following
		function:
			int search_binary_handler(struct linux_binprm *bprm);
		located in the fs/exec.c file. The SFD handler declared in
			include/linux/sf_security.h.
		SFD function name is:
			int sf_security_bprm_check(struct linux_binprm* pBinaryParameters);

config SECURITY_SFD_DISPATHCER_MMAP
	bool "Process MMAP system call"
	depends on SECURITY_SFD_DISPATCHER
	default n
	help
		This option enable mmap (sys_mmap, sys_mmap2, sys_mmap_pgoff, etc.) system call processing
		routine for Security Framework modules. This is done by adding a call into the following
		functions:
			unsigned long vm_mmap_pgoff(struct file *file, unsigned long addr,
				unsigned long len, unsigned long prot,
				unsigned long flag, unsigned long pgoff);
		located in mm/util.c file and:
			long do_shmat(int shmid, char __user *shmaddr, int shmflg, ulong *raddr,
				unsigned long shmlba);
		located in ipc/shm.c. The SFD handler declared in include/linux/sf_security.h. SFD function
		name is:
			int sf_security_mmap_file(struct file* pFile, unsigned long prot, unsigned long flags);

config SECURITY_SFD_DISPATCHER_LOAD_KERNEL_MODULE
	bool "Loading module into kernel"
	depends on SECURITY_SFD_DISPATCHER
	default n
	help
		This option enable kernel module (insmod, modprobe) loading system call processing routine
		for Security Framework modules. This is done by adding a call into following functions:
			static int copy_module_from_user(const void __user *umod, unsigned long len,
				struct load_info *info);
		located in kernel/module.c file and:
			static int copy_module_from_fd(int fd, struct load_info *info);
		located in kernel/module.c. The SFD handler declared in include/linux/sf_security.h.
		SFD function name is:
			int sf_security_kernel_module_from_file(struct file* pFile);

config SECURITY_SFD_DISPATCHER_OPEN
	bool "Process OPEN system call"
	depends on SECURITY_SFD_DISPATCHER
	default n
	help
		This option enable open (sys_open) system call processing routine for Security Framework
		modules. This is done by adding a call into following function:
			static int do_dentry_open(struct file *f, int (*open)(struct inode *, struct file *),
				const struct cred *cred);
		located in fs/open.c. The SFD handler declared in include/linux/sf_security.h. SFD function
		name is:
			int sf_security_file_open(struct file* pFile, const struct cred* pCredentials);

config SECURITY_SFD_DISPATHCER_CONNECT
	bool "Process CONNECT system call"
	depends on SECURITY_SFD_DISPATCHER
	default n
	help
		This option enable connect (sys_connect) system call processing routine for Security
		Framework modules. This is done by adding a call into following function:
			SYSCALL_DEFINE3(connect, int, fd, struct sockaddr __user *, uservaddr, int, addrlen);
		located in net/socket.c. The SFD handler declared in include/linux/sf_security.h.
		SFD function name is:
			int sf_security_socket_connect(struct socket* pSocket, struct sockaddr* pAddress,
				int addrlen);

config SECURITY_SFD_DISPATHCER_LISTEN
	bool "Process LISTEN system call"
	depends on SECURITY_SFD_DISPATCHER
	default n
	help
		This option enable listen (sys_listen) system call processing routine for Security Framework
		modules. This is done by adding a call into following function:
			SYSCALL_DEFINE2(listen, int, fd, int, backlog);
		located in net/socket.c. The SFD handler declared in include/linux/sf_security.h.
		SFD function name is:
			int sf_security_socket_listen(struct socket* pSocket, int backLog);

config SECURITY_SFD_DISPATCHER_SOCKET
	bool "Process SOCKET system call"
	depends on SECURITY_SFD_DISPATCHER
	default n
	help
		This option enable socket (sys_socket) system call processing routine for Security Framework
		modules. This is done by adding a call into following functions:
			int sock_create_lite(int family, int type, int protocol, struct socket **res);
		located in net/socket.c and:
			int __sock_create(struct net *net, int family, int type, int protocol,
				struct socket **res, int kern);
		located in net/socket.c. The SFD handler declared in include/linux/sf_security.h.
		SFD function name is:
			int sf_security_socket_create(int family, int type, int protocol, int kernel);

config SECURITY_SFD_DISPATCHER_ACCEPT
	bool "Process ACCEPT system call"
	depends on SECURITY_SFD_DISPATCHER
	default n
	help
		This option enable socket (sys_accept) system call processing routine for Security Framework
		modules. This is done by adding a call into following function:
			SYSCALL_DEFINE4(accept4, int, fd, struct sockaddr __user *, upeer_sockaddr,
				int __user *, upeer_addrlen, int, flags);
		located in net/socket.c. The SFD handler declared in include/linux/sf_security.h.
		SFD function name is:
			int sf_security_socket_accept(struct socket* pSocket, struct socket* pNewSocket);

config SECURITY_SFD_DISPATHCER_BIND
	bool "Process BIND system call"
	depends on SECURITY_SFD_DISPATCHER
	default n
	help
		This option enable bind (sys_bind) system call processing routine for Security Framework
		modules. This is done by adding a call into following function:
			SYSCALL_DEFINE3(bind, int, fd, struct sockaddr __user *, umyaddr, int, addrlen);
		located in net/socket.c. The SFD handler declared in include/linux/sf_security.h
		SFD function name is:
			int sf_security_socket_bind(struct socket* pSocket, struct sockaddr* pAddress,
				int addrSize);
				
```

## security/sfd/notifier/Kconfig
```kconfig
#
# Notification service module configuration
#

config SECURITY_SFD_NOTIFIER
	tristate "Notifier (Notification service)"
	depends on SECURITY_SFD_DISPATCHER
	default n
	help
		Notifier is reponsible for sending packets about system events to the user-space
		applications. It uses BUS created by Dispatcher. This module may be compiled in built-in
		mode as well as loadable.

		If you unsure how to answer this question, answer N.
```

## security/sfd/uep/Kconfig
```kconfig
#
# Unauthorized Execution Prevention service module configuration
#

config SECURITY_SFD_UEP
	tristate "UEP (Unauthorized Execution Prevention)"
	depends on SECURITY_SFD_DISPATCHER
	depends on (SECURITY_SFD_DISPATHCER_MMAP || SECURITY_SFD_DISPATHCER_EXEC || SECURITY_SFD_DISPATCHER_LOAD_KERNEL_MODULE)
	default n
	help
		UEP module responsible for digital signature verification of the executable binaries and
		loadable libraries. This module may be compiled built-in as well as loadable module.

		If you unsure how to answer this question, answer N.

config SECURITY_SFD_UEP_CHECK_LIBRARY
	bool "Library signature verification"
	depends on SECURITY_SFD_UEP && SECURITY_SFD_DISPATHCER_MMAP
	default n
	help
		Enable verification of the libraries going to be loaded.

config SECURITY_SFD_UEP_CHECK_PROCESS
	bool "Process signature verification"
	depends on SECURITY_SFD_UEP && SECURITY_SFD_DISPATHCER_EXEC
	default n
	help
		Enable verification of the applications going to be executed.

config SECURITY_SFD_UEP_CHECK_MODULE
	bool "Kernel module signature verification"
	depends on SECURITY_SFD_UEP && SECURITY_SFD_DISPATCHER_LOAD_KERNEL_MODULE
	default n
	help
		Enable verification of the kernel modules going to be loaded to the kernel.

config SECURITY_SFD_UEP_SIGNATURE_CACHE
	bool "Caching of the signature verification"
	depends on SECURITY_SFD_UEP
	default n
	help
		Enable caching of the digital signature verification routine. This is done by
		storing inode counters and comparing them on the next verification.

choice
	prompt "Default UEP Crytpography"
	depends on SECURITY_SFD_UEP

	config SECURITY_SFD_UEP_CRYPTO_MPI
		bool "MPI based cryptography"
		select MPILIB
		select CRYPTO_MD5
		help
			MPI library for big numbers arithmetic

	config SECURITY_SFD_UEP_CRYPTO_HW
		bool "HW based cryptography"
		help
			Chip accelerated cryptography. Currenly not supported. This option is for future.

	config SECURITY_SFD_UEP_CRYPTO_CRYPTOCORE
		bool "CryptoCore based cryptography"
		help
			CryptoCore library is Samsung Electronics engine for crypto operations. Currenly not
			supported. This option is for future.

endchoice
```

## security/smack/Kconfig
```kconfig
config SECURITY_SMACK
	bool "Simplified Mandatory Access Control Kernel Support"
	depends on NET
	depends on INET
	depends on SECURITY
	select NETLABEL
	select SECURITY_NETWORK
	default n
	help
	  This selects the Simplified Mandatory Access Control Kernel.
	  Smack is useful for sensitivity, integrity, and a variety
	  of other mandatory security schemes.
	  If you are unsure how to answer this question, answer N.


config SECURITY_SMACK_SYSTEM_MODE
	bool "SMACK system mode setting"
	depends on SECURITY_SMACK
	default n
	---help---
	Using this option we can select system wide mode for SMACK module.
	If it is set to y in that case there will be SMACK permissive mode
	and rule list check for different system calls but no permission error.
	By default this is set to y.

config SECURITY_SMACK_LOG_FOR_REL
    bool "SMACK remove the limitation of audit log for release version"
    depends on SECURITY_SMACK
    depends on AUDIT
    default n
	---help---
	Using this option we can remove limitation of smack error log.
	If we use this option smack log will not be lost . This option categorise
	printk log level as given below.
	log count less than 10 : KERN_ERR
	log count more than 10 : KERN_INFO
```

## sound/soc/codecs/yamaha_ymu835/Kconfig
```kconfig
config SND_SOC_YAMAHA_YMU831
	tristate "Build Yamaha CODEC YMU835 drivers"
	default y if SND_SOC_I2C_AND_SPI
	depends on SND_SOC && I2C
	select SND_HWDEP

config SND_SOC_YAMAHA_YMU831_DEBUG
	bool "YAMAHA_YMU831 verbose debug messages while core driver call"
	select SND_DEBUG
	depends on SND_SOC_YAMAHA_YMU831

config SND_SOC_YAMAHA_YMU831_SPI
	tristate "Build Yamaha CODEC YMU835 SPI driver"
	depends on SND_SOC
```

## sound/soc/sdp/Kconfig
```kconfig
config SDP_ALSA_AUDIO
	tristate "SDP  Audio - alsa pcm driver"
	depends on ARCH_SDP	
	default y	

config SDP_ALSA_COMPRESS_AUDIO
	tristate "SDP  Audio - alsa compress driver"
	depends on ARCH_SDP	
	default y	
```
