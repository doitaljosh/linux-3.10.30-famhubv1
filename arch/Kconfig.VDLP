## drivers/staging/android/Kconfig
```kconfig
menu "Android"

config ANDROID
	bool "Android Drivers"
	default N
	---help---
	  Enable support for various drivers needed on the Android platform

if ANDROID

config ANDROID_BINDER_IPC
	bool "Android Binder IPC Driver"
	default n
	---help---
	  Binder is used in Android for both communication between processes,
	  and remote method invocation.

	  This means one Android process can call a method/routine in another
	  Android process, using Binder to identify, invoke and pass arguments
	  between said processes.

config ASHMEM
	bool "Enable the Anonymous Shared Memory Subsystem"
	default n
	depends on SHMEM
	---help---
	  The ashmem subsystem is a new shared memory allocator, similar to
	  POSIX SHM but with different behavior and sporting a simpler
	  file-based API.

	  It is, in theory, a good memory allocator for low-memory devices,
	  because it can discard shared memory units when under memory pressure.

config ANDROID_LOGGER
	tristate "Android log driver"
	default n
	---help---
	  This adds support for system-wide logging using four log buffers.

	  These are:

	      1: main
	      2: events
	      3: radio
	      4: system

	  Log reading and writing is performed via normal Linux reads and
	  optimized writes. This optimization avoids logging having too
	  much overhead in the system.

config TIZEN_TV_DLOG_MANAGER
	bool "Managing for TIZEN TV Logging System(ANDROID_LOGGER)"
	depends on ANDROID_LOGGER
	default n
	help
	  Tizen TV use the logging system using this android logger driver.
	  The user level utility is dlog, but now this logger driver
	  have only 256K buffer, so it have some issue to disappear log
	  because of buffer full( 256K ).
	  So it need to control logs by user level process.
	  This driver will support this functionality. 

config TIZEN_TV_DLOG_DEBUG
    bool "Managing for TIZEN TV Logging System buffer(ANDROID_LOGGER)"
    depends on ANDROID_LOGGER
    default n
    help
      Tizen TV use the logging system using this android logger driver.
      The user level utility is dlog, but now this logger driver
      have only 256K buffer, so This config to change buffer size bigger for each device.

config ANDROID_TIMED_OUTPUT
	bool "Timed output class driver"
	default y

config ANDROID_TIMED_GPIO
	tristate "Android timed gpio driver"
	depends on GPIOLIB && ANDROID_TIMED_OUTPUT
	default n

config ANDROID_LOW_MEMORY_KILLER
	bool "Android Low Memory Killer"
	default N
	---help---
	  Registers processes to be killed when memory is low

config VD_LOW_MEMORY_KILLER
	bool "VD Low Memory Killer core"
	default N
	help
		Core infrastructure for VD Low Memory Killer module

config LMK_PRELOAD_APP
	bool "LMK policy to kill Preloaded Applications"
	depends on VD_LOW_MEMORY_KILLER
	default y
	help
	  With this option enabled, LMK first kills tasks with highest
	  preload_prio value.

config ANDROID_INTF_ALARM_DEV
	bool "Android alarm driver"
	depends on RTC_CLASS
	default n
	---help---
	  Provides non-wakeup and rtc backed wakeup alarms based on rtc or
	  elapsed realtime, and a non-wakeup alarm on the monotonic clock.
	  Also exports the alarm interface to user-space.

config SYNC
	bool "Synchronization framework"
	default n
	select ANON_INODES
	help
	  This option enables the framework for synchronization between multiple
	  drivers.  Sync implementations can take advantage of hardware
	  synchronization built into devices like GPUs.

config SW_SYNC
	bool "Software synchronization objects"
	default n
	depends on SYNC
	help
	  A sync object driver that uses a 32bit counter to coordinate
	  syncrhronization.  Useful when there is no hardware primitive backing
	  the synchronization.

config SW_SYNC_USER
	bool "Userspace API for SW_SYNC"
	default n
	depends on SW_SYNC
	help
	  Provides a user space API to the sw sync object.
	  *WARNING* improper use of this can result in deadlocking kernel
	  drivers from userspace.

endif # if ANDROID

endmenu
```

## drivers/vd_time/Kconfig
```kconfig
config VDTIME_SUPPORT
	bool "VD-Time support device"
	default y
	help
	  This option provides a aupport for VD kernel time feature.
	  VD time contains absolute time shift from UTC, time zone
	  and daylight saving time.
```

## fs/exfat/Kconfig
```kconfig
config EXFAT_FS
	tristate "exFat File System Support"
	select NLS
	default y
	help
	  This enables the exfat filesystem support in Kernel.
	  To compile this as a module, choose M here.
```

## fs/vdfs/Kconfig
```kconfig
config VDFS_FS
	tristate "Samsung VDFS file system support (EXPERIMENTAL)"
	depends on BLOCK
	select NLS
	select CRC32
	default n
	help
	  If you say Y here, you will be able to mount format
	  VDFS-formatted hard drive partitions with full read-write access.

	  To compile this code as a module, choose M here: the module will be
	  called emmcfs.

	  If unsure, say N.

config VDFS_POSIX_ACL
	bool "Support of Posix ACL"
	depends on VDFS_FS
	select FS_POSIX_ACL
	help
	  POSIX Access Control Lists (ACLs) support permissions for users and
	  groups beyond the owner/group/world scheme. See man 5 acl for details.

config VDFS_DEBUG
	bool "Debug VDFS"
	depends on VDFS_FS
	help
	  If you say Y here, you can use the 'debug' mount option to enable
	  debugging output from the driver.

	  If unsure, say N.

config VDFS_PANIC_ON_ERROR
	bool "Force kernel panic after fatal errors"
	depends on VDFS_FS
	default y
	help
	  If you say Y here first disk error or metadata corruption will cause
	  kernel panic. This mode should be used in release builds.

	  Otherwise filesystem will be automatically remounted into read-only
	  mode for preventing further corruption, after that it hopefully can
	  be unmounted without crashing whole kernel. All unwritten data will
	  be lost. This mode is useful for testing.

config VDFS_NOOPTIMIZE
	bool "Disable build optimization for VDFS"
	depends on VDFS_FS
	help
	  If you say Y here, VDFS will be built with -O0 opt. Useful for
	  gdb debug;

	  If unsure, say N.

config VDFS_STATISTIC
	bool "Umount statistic"
	depends on VDFS_FS
	help
	  This feature allows to count amount of data writen to block
	  device during umount operation. At the end of umount, it
	  displays a message with appropriate value.

	  If unsure, say N.

	
config VDFS_EXPERIMENTAL
	bool "VDFS Experimental Features (EXPERIMENTAL)"
	depends on VDFS_FS && EXPERIMENTAL

	help
	  Enables VDFS features under testing. These features are
	  experimental.

	  If unsure, say N.

config VDFS_OLDEST_LAYOUT_VERSION
	int "The oldest supported version of on-disk layout"
	default 441
	range 441 9999
	depends on VDFS_FS
	help
	  
	  VDFS volume should be formated by mkfs.vdfs utility not older
	  than specified version.
	  Older versions will be rejected by driver at mount time.

	  Cann't be less then 331
	  
	  If unsure, leave default value

config VDFS_CRC_CHECK
	bool "VDFS CRC check"
	depends on VDFS_FS
	help
		Enables CRC check for VDFS metadata

		If unsure, say N.

config VDFS_META_SANITY_CHECK
        bool "VDFS metadata sanity check"
        depends on VDFS_FS
        help
                This feature adds additional checks for VDFS metadata,
		to find metadata corruption on early stage, and prevent
		writing incorrect data to flash.

                If unsure, say N.

config VDFS_QUOTA
	bool "VDFS quotas feature"
	depends on VDFS_FS
	help
		Enables quotas feature. This feature allows the vdfs image
		creator to allocate a maximum amount of disk space a user or
		group may use. Quota can be set only during image
		creation, changes at runtime not permitted.

		If unsure, say N.

config VDFS_HW2_SUPPORT
	bool "Use HW2 API to decompress user data from installed SMART package"
	depends on ARCH_SDP
	depends on VDFS_FS
	depends on MMC
	depends on HW_DECOMP_BLK_MMC_SUBSYSTEM
	select SDP_UNZIP
	select SDP_UNZIP_TEST_DRIVER
	help
	  Utilize hardware decompressor to decompress packed user data from
	  installed Squashfs imgages;

config VDFS_RETRY
	bool "Enable/disable retry decompression and authentication"
	depends on VDFS_FS
	help
		In case of unsuccessfull decompresssion/authentication retry to
		decompress/authenticate	data 3 times till successfull result;

		If unsure, say N.

config VDFS_DATA_AUTHENTICATION
	bool "User data and vdfs meta authentication"
	depends on VDFS_FS
	depends on (RSA2048 && CRYPTO_SHA1)
	help
		Protect the vdfs superblock, file-based meta data and compressed chunks
		by digital signature. The VDFS uses SHA1+RSA2048 algorithms to
		calculate the digital signatures;

config VDFS_EXEC_ONLY_AUTHENTICATED
	bool "Execute and read only signed binaries and files"
	depends on VDFS_FS
	depends on VDFS_DATA_AUTHENTICATION
	help
		If the option is set only authenticated binary can be run. The vdfs
		checks for inode flag, if the flag is set it allows to do mmap with
		VM_EXEC bit set and do not clear VM_MAYEXEC on vma

config VDFS_DEBUG_AUTHENTICAION
	depends on VDFS_DATA_AUTHENTICATION
	bool "if enable - do not return an error if authenticaion is failed."
	help
		if enable - if authentication is enabled do not return an error
		and print error message
		if diable - if return an error if authenticaion is failed
	default n
```

## fs/vdfs2/Kconfig
```kconfig
config VDFS_FS
	tristate "Samsung VDFS file system support (EXPERIMENTAL)"
	depends on BLOCK
	select NLS
	select CRC32
	default n
	help
	  If you say Y here, you will be able to mount format
	  VDFS-formatted hard drive partitions with full read-write access.

	  To compile this code as a module, choose M here: the module will be
	  called emmcfs.

	  If unsure, say N.

config VDFS_NFS_SUPPORT
	bool "Support of NFS"
	depends on VDFS_FS
	help
	  If you say Y here, you can export the file system via NFS. NOTE:
	  VDFS doesn't support permanent file export. i.e. if NFS server
	  will be rebooted, all opened files  on clients side will be
	  invalidated.

	  If unsure, say N.

config VDFS_DEBUG
	bool "Debug VDFS"
	depends on VDFS_FS
	help
	  If you say Y here, you can use the 'debug' mount option to enable
	  debugging output from the driver.

	  If unsure, say N.

config VDFS_NOOPTIMIZE
	bool "Disable build optimization for VDFS"
	depends on VDFS_FS
	help
	  If you say Y here, VDFS will be built with -O0 opt. Useful for
	  gdb debug;

	  If unsure, say N.

config VDFS_STATISTIC
	bool "Umount statistic"
	depends on VDFS_FS
	help
	  This feature allows to count amount of data writen to block
	  device during umount operation. At the end of umount, it 
	  displays a message with appropriate value.
		
	  If unsure, say N. 

	
config VDFS_EXPERIMENTAL
	bool "VDFS Experimental Features (EXPERIMENTAL)"
	depends on VDFS_FS && EXPERIMENTAL

	help
	  Enables VDFS features under testing. These features are
	  experimental.

	  If unsure, say N.

config VDFS_OLDEST_LAYOUT_VERSION
	int "The oldest supported version of on-disk layout"
	default 441
	range 441 9999
	depends on VDFS_FS
	help
	  
	  VDFS volume should be formated by mkfs.vdfs utility not older
	  than specified version.
	  Older versions will be rejected by driver at mount time.

	  Cann't be less then 331
	  
	  If unsure, leave default value

config VDFS_CRC_CHECK
	bool "VDFS CRC check"
	depends on VDFS_FS
	help
		Enables CRC check for VDFS metadata

		If unsure, say N.

config VDFS_META_SANITY_CHECK
        bool "VDFS metadata sanity check"
        depends on VDFS_FS
        help
                This feature adds additional checks for VDFS metadata,
		to find metadata corruption on early stage, and prevent
		writing incorrect data to flash.

                If unsure, say N.

config VDFS_QUOTA
	bool "VDFS quotas feature"
	depends on VDFS_FS
	help
		Enables quotas feature. This feature allows the vdfs image
		creator to allocate a maximum amount of disk space a user or
		group may use. Quota can be set only during image
		creation, changes at runtime not permitted.

		If unsure, say N.

config VDFS_PROC
	bool "VDFS print path to files which has a dirty pages"
	depends on VDFS_FS
	help
		VDFS file driver prints a path to files which has a dirty
		pages via proc file system

		If unsure, say N.

config VDFS_HW2_SUPPORT
	bool "Use HW2 API to decompress user data from installed SMART package"
	depends on ARCH_SDP
	depends on VDFS_FS
	depends on MMC
	depends on HW_DECOMP_BLK_MMC_SUBSYSTEM
	select SDP_UNZIP
	select SDP_UNZIP_TEST_DRIVER
	help
	  Utilize hardware decompressor to decompress packed user data from
	  installed Squashfs imgages;

config VDFS_SW_DECOMPRESS_RETRY
	bool "Enable/disable retry decompression of squashfs chunck"
	depends on VDFS_FS
	help
		In case of unsuccessfull decompresssion retry to decompress
		chunck for 3 times till successfull result;

		If unsure, say N.
```

## lib/Kconfig.kasan
```kconfig
config HAVE_ARCH_KASAN
	bool

if HAVE_ARCH_KASAN

config KASAN
	bool "AddressSanitizer: dynamic memory error detector"
	depends on SLUB
	depends on !DEBUG_PAGEALLOC
	depends on !KMEMCHECK
	select STACKTRACE
	default n
	help
	  Enables AddressSanitizer - dynamic memory error detector,
	  that finds out-of-bounds and use-after-free bugs.

config KASAN_SANITIZE_ALL
	bool "Sanitize entire kernel"
	depends on KASAN
	default y
	help
	  This option activates instrumentation for the entire kernel.

config KASAN_SLAB
	bool "Address sanitizer for low memory"
	depends on KASAN
	depends on SLUB
	default y
	help
	  Enables address sanitzier for slub and buddy allocators.

config KASAN_STACK
	bool "Address sanitizer for stack area"
	depends on KASAN && KASAN_SLAB
	default n
	help
	  Enable address sanitizer to detect out-of-bounds accesses
	  on stack variables

config KASAN_VMALLOC
	bool "Address sanitizer for vmalloc"
	depends on KASAN
	default y
	help
	  Enable address sanitzier for vmalloc allocator.

config KASAN_GLOBALS
	bool "Address sanitzier for global variables"
	depends on KASAN && KASAN_SLAB
	select CONSTRUCTORS
	default y
	help
	  Address sanitizer for global variables.

config KASAN_UAR
	bool "Address sanitzier use after return detection"
	depends on KASAN && KASAN_STACK
	default y
	help
	  This option enables use after return detector.

config KASAN_TESTS
	tristate "Build address sanitizer self-tests"
	depends on KASAN
	default n
	help
	  This option provides a kernel module that can be used to
	  test kernel address sanitzer. Tests allocate memeory via
	  kmalloc/kmem_cache_alloc and do various nasty things like
	  out of bounds access, use after free...

endif
```

## lib/sf/Kconfig
```kconfig
#
# Kernel config file for Security Framework libraries
#
menu "Security Framework libraries"

config SFLIB
	bool "Security Framework libraries"
	default n
	depends on SECURITY_SFD
	select SFLIB_CORE
	help
		Select Security Framework Libraries to interact with kernel security
		modules. Security Framework API consist of 3 major components:
			1. Core component encaplulates basic data types and primitives.
			2. Protocol component encapsulates operational structures.
			3. Transport component provide mechanism for communication between
				kernel components and user-space components.

source lib/sf/core/Kconfig
source lib/sf/protocol/Kconfig
source lib/sf/transport/Kconfig

endmenu
```

## lib/sf/core/Kconfig
```kconfig
config SFLIB_CORE
	bool "Core component of the Security Framework"
	default n
	depends on SFLIB
	help
		To write information later
```

## lib/sf/protocol/Kconfig
```kconfig
config SFLIB_PROTOCOL
	bool "Protocol component of the Security Framework"
	default n
	depends on SFLIB_CORE
	help
		To write information later
```
