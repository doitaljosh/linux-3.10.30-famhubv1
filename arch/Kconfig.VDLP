## drivers/Kconfig.DEBUG
```kconfig
menu "Samsung SABSP DEBUG patch"
comment "VDLinux Debug patch"

config VD_RELEASE
    default n
    bool "Turn on Release mode"
    help
     Set Debug/Release mode (n : Debug / y : Release)

config UNHANDLED_IRQ_TRACE_DEBUGGING
	bool "trace unhandled irq tracing"
	depends on VD_RELEASE=n
	default n

config FCOUNT_DEBUG
   bool "print f_count when umount fail(task info also is printed when CONFIG_FD_PID is enable) "
   depends on VD_RELEASE=n
   default n

config UART_BROADCAST
   bool "tty broadcast"
   default y

config IRQ_TIME
   bool "IRQ_TIME"
   default n
   depends on VD_RELEASE=n
   depends on UNHANDLED_IRQ_TRACE_DEBUGGING
   help
     It prints the time of irqs

config PROHIBIT_SIG
	int "Prohibit SIGNAL"
	default "99"
	depends on VD_RELEASE=n
	help
	 It makes coredump

config OPEN_FILE_CHECKER
	bool "In case of too many open files, It prints open file information"
	default y
	help
	  It prints open file information.
	  also if the FD_PID is enabled, open thread information is supported.

config RUN_TIMER_DEBUG
	bool "run timer debugging"
	depends on VD_RELEASE=n

config SCHED_HISTORY_ON_DDR
	bool "enable sched_history_on_ddr"
	default n
	help
	  DEBUG TOOL : schedule history on ddr	 

config SCHED_HISTORY_ON_DDR_BUFADDR
	hex "sched_history_on_ddr buffer address"
	depends on SCHED_HISTORY_ON_DDR
	help
	  set buffer address for sched_history_on_ddr

config ENABLE_OOM_DEBUG_LOGS
	default n
	bool "Enable OOM debug logs"
	depends on VD_RELEASE=y
	help
	 Set console message log level to KERN_DEBUG(7)
	 temporarily for enabling the OOM debug logs,
	 when VD_RELEASE mode is set.

config TRACE_SYS_WRITE
	default n
	bool "Trace sys_write call (access file,thread)"
	depends on VD_RELEASE=n
	help
	 Print file access information and thread name 
	 While sys_write is called.

config PM_CRC_CHECK
	default y
	bool "CRC checking to check DDR status easily (without PM_CRC_CHECK_AREA_SELECT : Kernel text section)"
	depends on VD_RELEASE=n
	depends on EXECUTE_AUTHULD=y
	depends on PM=y

config PM_CRC_CHECK_AREA_SELECT
	default n
	bool "Select CRC check area related with PM_CRC_CHECK function"
	depends on PM_CRC_CHECK=y

config PM_CRC_CHECK_AREA_START
	hex "PM CRC check start address (hex)"
	depends on PM_CRC_CHECK_AREA_SELECT

config PM_CRC_CHECK_AREA_SIZE
	hex "PM CRC check size (hex)"
	depends on PM_CRC_CHECK_AREA_SELECT

config TRACE_SYS_SYNC_FSYNC
	default n
	bool "Trace sync/fsync call (access file,thread)"
	depends on VD_RELEASE=n
	help
	 Print file access information and thread name 
	 While sync/fsync is called.

endmenu
```

## drivers/brcm/Kconfig
```kconfig
menu "Broadcom Bluetooth device drivers"

menuconfig BLUEDROID
	tristate "Bluedroid Bluetooth stack drivers"
	help
	  Bluetooth is low-cost, low-power, short-range wireless technology.
	  It was designed as a replacement for cables and other short-range
	  technologies like IrDA.  Bluetooth operates in personal area range
	  that typically extends up to 10 meters.  More information about
	  Bluetooth can be found at <http://www.bluetooth.com/>.

	  Bluedroid subsystem consists of user space stack and Kernel drivers:
	    User space stack which includes implementation of:
	     HCI
	     RFCOMM
	     L2CAP
	     Other protocols and profiles

	  Say Y here to compile Bluedroid driver support into the kernel or say M to
	  compile it as module (btusb).

	  These drivers are required in order to use Bluedroid stack in user space.

config BT_BCMBTUSB
	tristate "BCM BT USB driver"
	depends on USB && BLUEDROID
	help
	  Broadcom Bluetooth HCI USB driver.
	  This driver is required if you want to use Bluetooth devices with
	  USB interface and a stack entirely running in user space. This driver
	  provides device node interface to user space for interaction.

	  Say Y here to compile support for Bluetooth USB devices into the
	  kernel or say M to compile it as module (btusb).

config BT_AUDIOLITE
	tristate "BT USB Lite driver"
	depends on BT_BCMBTUSB
	help
	  Broadcom Bluetooth HCI Lite driver.
	  This driver is required if you want to use Kernel implementation of
	  SBC encoder and AVDTP.

	  Say Y here to compile support for BT USB Lite into the
	  kernel or say M to compile it as module (btsbc & btpcm).
endmenu
```

## drivers/media/platform/sdp-dvb/Kconfig
```kconfig
config DVB_SDP
	tristate "SDP DVB base driver"
	depends on DVB_CORE
	depends on ARCH_SDP
	default n
	help
	  DVB base drivers for SDP.

config DVB_SDP_CHANNEL
	tristate "SDP DVB demodulator driver"
	depends on DVB_SDP
	default n
	help
	  DVB demodulator driver for SDP.
```

## drivers/media/usb/uvc/Kconfig
```kconfig
config USB_VIDEO_CLASS
	tristate "USB Video Class (UVC)"
	select VIDEOBUF2_VMALLOC
	---help---
	  Support for the USB Video Class (UVC).  Currently only video
	  input devices, such as webcams, are supported.

	  For more information see: <http://linux-uvc.berlios.de/>

config USB_VIDEO_CLASS_INPUT_EVDEV
	bool "UVC input events device support"
	default y
	depends on USB_VIDEO_CLASS
	depends on USB_VIDEO_CLASS=INPUT || INPUT=y
	---help---
	  This option makes USB Video Class devices register an input device
	  to report button events.

	  If you are in doubt, say Y.

config USB_VIDEO_TV_CAMERA
	bool "UVC driver for Samsung TV embedded camera"
	depends on USB_VIDEO_CLASS
	---help---
          Support for the Samsung TV embedded camera. This option makes
          USB Video Class devices to multiple streaming(main, sub)
	  If you are in doubt, say N.

config USB_VIDEO_TV_CAMERA_MAIN
        int "Node number of Main stream(GRAY frame)"
        depends on USB_VIDEO_TV_CAMERA
        default 240
        range 1 255

config USB_VIDEO_TV_CAMERA_SUB
        int "Node number of Sub stream(H.264 frame)"
        depends on USB_VIDEO_TV_CAMERA
        default 241
        range 1 255
```

## drivers/misc/micom-msg/Kconfig
```kconfig
#
# Micom Interfaces for CEC/Normal Buffer data.
#
config AR_WT61P807
	tristate "Micom Auto Remocon driver support for WT61P807"
	depends on ARCH_SDP
	depends on MFD_SDP_MICOM
	help
	  Support for the WT61P807 Auto Remocon data.

config ISP_WT61P807
	tristate "Micom ISP data support for WT61P807"
	depends on ARCH_SDP
	depends on MFD_SDP_MICOM
	help
	  Support for the WT61P807 ISP data, this is required for updating
	  submicom firmware.

config BRIGHTNESS_SENSOR_WT61P807
	tristate "Brightness sensor support for WT61P807"
	depends on ARCH_SDP
	depends on MFD_SDP_MICOM
	help
	  Support for the WT61P807 brightness sensor driver

config ONTIMER_WT61P807
	tristate "Ontimer support for WT61P807"
	depends on ARCH_SDP
	depends on MFD_SDP_MICOM
	help
	  If you say yes here you get support for WT61P807 timer module.
	  This driver can also be built as a module, if so, the module
	  will be called "timer-wt61p807".

config SYSTEM_WT61P807
	tristate "System support for WT61P807"
	depends on ARCH_SDP
	depends on MFD_SDP_MICOM
	help
	  If you say yes here you get support for WT61P807 system module
	  such as power on mode.

config CEC_WT61P807
	tristate "Micom interface for CEC data"
	default n
	depends on MFD_SDP_MICOM
	help
	  This is an interface for micom cec data comuunication.

config MSG_WT61P807
	tristate "Micom interface for Normal Buffer data"
	default n
	depends on MFD_SDP_MICOM
	help
	  This driver provides the interface to transmit the Normal Buffer data for sending messages to Micom.
```

## drivers/mmc/Kconfig
```kconfig
#
# MMC subsystem configuration
#

menuconfig MMC
	tristate "MMC/SD/SDIO card support"
	depends on HAS_IOMEM
	help
	  This selects MultiMediaCard, Secure Digital and Secure
	  Digital I/O support.

	  If you want MMC/SD/SDIO support, you should say Y here and
	  also to your specific host controller driver.

config MMC_DEBUG
	bool "MMC debugging"
	depends on MMC != n
	help
	  This is an option for use by developers; most people should
	  say N here.  This enables MMC core and driver debugging.

config HW_DECOMP_BLK_MMC_SUBSYSTEM
	bool "HW decompression from the MMC layer"
	depends on MMC != n
	select SDP_UNZIP
	help
		This option enables hardware decompression from MMC layer.
		Fs layer should be aware of this special call and should
		use it properly.

if MMC

source "drivers/mmc/core/Kconfig"

source "drivers/mmc/card/Kconfig"

source "drivers/mmc/host/Kconfig"

endif # MMC
```

## drivers/power/avs/Kconfig
```kconfig
menuconfig POWER_AVS
	bool "Adaptive Voltage Scaling class support"
	help
	  AVS is a power management technique which finely controls the
	  operating voltage of a device in order to optimize (i.e. reduce)
	  its power consumption.
	  At a given operating point the voltage is adapted depending on
	  static factors (chip manufacturing process) and dynamic factors
	  (temperature depending performance).
	  AVS is also called SmartReflex on OMAP devices.

	  Say Y here to enable Adaptive Voltage Scaling class support.

if POWER_AVS

config SDP_AVS
	bool "Adaptive Voltage Scaling for SDP SoCs"
	depends on ARCH_SDP
	select POWER_SUPPLY
	default y

config SDP1304_AVS
	bool "SDP1304 AVS support"
	depends on SDP_AVS
	default n

config SDP1307_AVS
	bool "SDP1307 AVS support"
	depends on SDP_AVS
	default n

config SDP1404_AVS
	bool "SDP1404 MP AVS support"
	depends on SDP_AVS
	default n

config SDP1406_AVS
	bool "SDP1406 AVS support"
	depends on SDP_AVS
	default n

endif 
```

## drivers/samsung/Kconfig
```kconfig
menu "Samsung drivers"

source drivers/samsung/orsay/Kconfig
source drivers/samsung/bptime/Kconfig

endmenu
```

## drivers/samsung/bptime/Kconfig
```kconfig
menu "Broadcast Time Support"

config BPTIME
	bool "Broadcast Time Framwork Support"
	default y
	help
	  This configuration support broadcast time
	  to can share all of process between multi device.
	  This time driver will work with user process demon.
	  If the demon process dose not registered , It will be
	  shared time only one device included this kernel.

config BPTIME_DEMON
	bool "Enable the Functionality to can share time between multi device"
	default n
	help
	  This configration support broadcast time
	  to can share all of process between multi device.
	  For using this configuration , you have to develop
	  demon binary to can send the time information to
	  other device. And than please register this demon
	  full path in BPTIME_DEMON_NAME configration.

config BPTIME_DEMON_NAME
	string "Binary Location of Time Demon Process"
	default path/to/demon_binary
	depends on BPTIME_DEMON
	help
	  demon binary have to be registered that we assing.
	  this demon process to be request register will be
	  judged by this configuration.
endmenu
```

## drivers/sensors/Kconfig
```kconfig
#
# Sensor  drivers configuration
#
menuconfig SENSORS
	bool "Sensors Support"
	help
	  Say Y to enable Sensors support. This allows control of supported

if SENSORS

config SENSORS_CORE
	bool "sensors_core"
	depends on I2C
 
config SENSORS_BMI055
	tristate "BMI055 Combo Sensor Driver"
	depends on I2C
	default n
	help
	  If you say yes here you get support for Bosch-Sensortec's
	  BMA254 Acceleration & Gyroscope Sensor.

config SENSORS_AK8963C
	tristate "AK8963C compass support"
	default n
	depends on I2C
	help
	  If you say yes here you get support for Asahi Kasei's
	  orientation sensor AK8963.

config SENSORS_AK09911C
	tristate "AK09911C compass support"
	default n
	depends on I2C
	help
	  If you say yes here you get support for Asahi Kasei's
	  orientation sensor AK09911C.

config SENSORS_CM3323
	depends on I2C
	tristate "CM3323 driver"
	default n
	help
	  Say Y here if you use cm3323.
	  This option enables RGB sensors using
	  Capella cm3323 device driver.

	  Say N here if you do not use cm3323.

config SENSORS_CM36653
	depends on I2C
	tristate "CM36653 driver"
	default n
	help
	  Say Y here if you use cm36653.
	  This option enables RGB sensors using
	  Capella cm36653 device driver.

	  Say N here if you do not use cm36653.

config SENSORS_TMD27723
	depends on I2C
	tristate "TMD27723 driver"
	default n
	help
	   This option enables proximity & light sensors using TMD27723 driver.

config SENSORS_SX9500
	depends on I2C
	tristate "SX9500 driver"
	default n
	help
	  Say Y here if you use sx9500.
	  This option enables grip sensors using
	  SamTech cm3323 device driver.

	  Say N here if you do not use cm3323.

config SENSORS_LTR507
	depends on I2C
	tristate "LTR-507ALS-01 light sensor"
	default n
	help
	  If you say yes here you get support for the Lite-On LTR-507ALS-01
	  ambient light and proximity sensor.

	  This driver can also be built as a module.  If so, the module
	  will be called ltr507

config SENSORS_GP2Y
	tristate "GP2Y Sharp Proximity Sensor"
	default n
	help
	  If you say yes here you get support for the Shart GP2Y
	  proximity sensor.

	  This driver can also be built as a module.  If so, the module
	  will be called gp2y
endif # SENSORS

source "drivers/sensors/mpu6500/Kconfig"
```
