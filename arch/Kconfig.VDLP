## arch/arm/Kconfig.SABSP
```kconfig
menu "Samsung SP/BSP options"
comment "VDLinux 4.x SA/BSP patch"

config SAVELOGD
	bool "save error log deamon"
	default y
	help
	 It support save error log deamon

config EMRG_SAVE_KLOG
	bool "Save dmesg to raw partition on OOPs"
	default y
	help
	 Preform dmesg saving in raw-data format to specified partition.
	 Special low-level function are used to write the data, which are
	 supposed to be independent from kernel, and supposed to work at
	 any conditions.

config EMRG_SAVE_KLOG_PARTITION_N
	int "Which partition should be used for saving emrg dmesg"
	default 25
	depends on EMRG_SAVE_KLOG
	help
	 Partition /dev/mmcblk0p<this number> will be used to save the dmesg


config MINIMAL_CORE
	bool "Enable Small core dumps"
	default y
	depends on (COREDUMP=y && BINFMT_ELF=y)
	select RSA_API
	select ZLIB_DEFLATE
	help
	 coredump only current task for tracing crashes in Market with security
	 Will dump only crashed thread info, register context,
	 File info, stack of crashed thread,
	 and the areas in heap pointed by registers from r0-r12

config MINIMAL_CORE_RETAIN
	bool "Retain first 10 mincore files"
	default y
	depends on (MINIMAL_CORE=y)
	help
	  When this configuration is enabled, mincore will retain the first
	  10 files. If 10 files are already created, then this will print
	  an info to kernel log. This can be turned off, when latest
	  crash mincore are required

config MINCORE_RLIMIT_NOFILE
	bool "Enable creating mincore when RLIMIT_NOFILE is exceeded"
	default n
	depends on (MINIMAL_CORE=y && OPEN_FILE_CHECKER=y && FD_PID=y)
	help
	 create a mincore when a process crosses RLIMIT_NOFILE
	 This will create a mincore file which includes context & stack of
	 all owners (threads) of all file opened,
	 This will create a mincore with all threads which have a file open.

config USBEN_GPIO
	bool "gpio control support for usb power handling"
	default y
	help
	 It support gpio control for usb power 

config BLOCK_STOP_TTY
       bool "block stop_tty (Ctrl + S)"
       default y
       help
        Noise from UART can make stop signal. This option blocks stop_tty.

config MOUNT_SECURITY
       bool "security on mount command"
       default y
       help
        In case of release kernel build mode, This option will disable BIND option and apply NOEXEC option to all devices on mount command

config PROHIBIT_SIGNAL_HOOKING
		bool "coredump when user try signal_hooking"
		default n
		help
		In case of user app trying signal hooking, This option can stop user app and create coredump.

config PROHIBIT_USLEEP_0
		bool "coredump when user try usleep(0)"
		default n
		help
		In case of user app using usleep(0), This option can stop user app and create coredump.

config PREVENT_MIN_FREE_BYTES
		bool "prevent min_free_kbytes setting"
		default y
		help
			prevent min_free_kbytes setting from user (sysctl)

config MODULE_VER_CHECK_SKIP
		bool "Module version check skip"
		default n
		depends on MODVERSIONS=n
		help
		  'PRINT_MODULE_ADDR' option change VERMAGIC_STRING value. (e.g. 1003_192 DEBUG)
		  so, If you are using different version name, insmod will be failed
		  even while 'MODVERSION' option is off.
		  This option skip the checking the VERMAGIC_STRING.

config SQUASHFS_DEBUGGER
		bool "squashfs debugger v2.1"
		default y
		help
		  Tool for debugging squashfs error.
		  It is useful even to debug Flash I/O and memory un-safe problem.

config SQUASHFS_DEBUGGER_AUTO_DIAGNOSE
		bool "squashfs debugger auto diagnose"
		default y
		depends on SQUASHFS_DEBUGGER
		help
		  Diagnose the cause of squashfs error.

config MMC_BOOTING_SYNC
		bool "Wait rootfs mount try till mmc scan is done"
		default y
		help
		  If you use mmc device as rootfs, It could prevent mount fail issue.

config BUSYLOOP_WHILE_OOPS
		bool "busyloop while oops"
		default y
		help
			In case of oops, This option is useful for attach JTAG device.

config MMC_TIMEOUT
		bool "MMC_TIMEOUT"
		default n
		help
		  This config stops current mmc request.

config CA9_SYSTEM_HANG
		bool "CA9 SYSTEM HANG"
		default n
		help
		  This config decides whether it uses flush BTAC/BTB( Branch Target Buffer ) when context switch

config KPI_SYSTEM_SUPPORT
		bool "KPI (BP error check) system support"
		default n
		depends on SHOW_FAULT_TRACE_INFO
		help
	      It write error information(Tick, thread name, PC) when user fault is occured

config SWU_SUPPORT
		bool "SWU mode support for updating single exeDSP"
		default n
		help
		  For single exeDSP case, new update method/execution sequence are needed

config WRITE_PROTECT 
		bool "Flash write protection"
		default n
		help
		    Flash write protection

config MMC_POWER_ON_WRITE_PROTECTION
		bool "Use power on write protection"
		default n
		help
		  This will attemp to power on write protection for eMMC boot partition when eMMC init.

config USE_MESSAGEBOX_FOR_MICOM
		bool "Use MessageBox For Micom instead Uart"
		default n
		help
			It use MessageBox for send&receive data with Micom instead of UART.

config FUTEX_DLA
	bool "Futex deadlock analyzer"
	default y
	help
	 Enable to create dumps on futex deadlocks
	 It checks for owner of futex and tries to
	 get the thread which is respondible
	 for deadlock.

config FUTEX_DLA_TA
	bool "Enable time based analysis for wait time"
	default y
	depends on FUTEX_DLA
	help
	 Checks for wait time and reports dump
	 if greater than specified
	 its an optional configuration as
	 BP already checks for sleep time.

config FUTEX_DLA_TS
	int "max wait time considered as deadlock(in msec)"
	default 10000
	depends on FUTEX_DLA_TA
	help
	 If futex wait time is more than this
	 It will be considered as deadlock.
	 default value is 10000 msec.
	 Please choose it as per system configuration.

config MMC_CACHE_ON
	bool "Enable mmc cache"
	default n
	help
	 In 3.10 kernel, if mmc has cache, set use mmc cache as default.
	 Therefore, this config can help to turn on/off mmc cache.
	 If this config has set, mmc use cache which is located inside.

config SDP_MMC_RDQS_FIXUP
	bool "sdp mmc needs to be set rdqs value in driver code, differently"
	default n
	help
	 In sdp_mmc driver code, host cannot detect the card.
	 Hence, this config make the host can detect mmc card in driver code.

config SDP_MMC_EXECUTE_HS400_RDQS_TUNING
	bool "If sdp mmc uses HS400 mode, it needs to be tuned rdqs value after mmc reset"
	default n
	help
	 In sdp_mmc driver code, if host uses HS400 mode, execute rdqs tuning after the mmc reset.
	 Hence, this one should be skipped in first boot.

config NOTIFY_FILE_WRITE
	bool "Enable notify file write"
	default n
	help
	 To verify vdfs authentication feature, we have to know which process really write in rootfs(Read-Only) partition.

config MMC_DEBUG_IOCTL
	bool "Enable mmc debug ioctl"
	default n
	help
	 This feature depended on VD_RELEASE config.
	 Because of this reason(dependency), this feature only support in debug version, only.
	 However, we need update onboot binary file via ioctl in perf version.
	 Hence, create this config and remove the dependency between VD_RELESE and this feature. (VD_RELEASE -> MMC_DEBUG_IOCTL)
	 This config should be enalbed only in debug/perf version.

config MMC_CHECK_ENDURANCE
	bool "Check endurance of mmc by ext_csd[267~269]"
	default n
	help
	 Enable to read ext_csd[267~269] and check endurance.
	 If it is approached limitation, it will show warn message and make Panic.


endmenu # end of "Samsung SA/BSP options" menu
```

## arch/arm/Kconfig.Secure
```kconfig
menu "CI+ Option"

config PROHIBIT_DEVMEM
		bool "prohibit access to /dev/mem and /dev/kmem"
		default n 
		help
		  It will prevent to access to /dev/mem and /dev/kmem for security issue.

config PROHIBIT_GROUP_SETUID
		bool "prohibit setuid operation for preventing privilege rise"
		default n
		help
		  It will prevent to setuid implementation for security issue.

config USE_ARS
    bool "Anit RemoteShell Dummy function"
    default n

config PNACL
    bool "Modification for PNaCl"
    default n

config RSA_API
	default n
	bool "RSA API support"

config SHA_API
	default n
	bool "SHA API support"

config EXECUTE_AUTHULD
	default n
	depends on RSA_API=y && SHA_API=y
	bool "Execute authuld program on background" 
	help
		decide whether executing authuld

choice
	prompt "1024 or 2048 RSA"
	default RSA2048

config RSA2048
	bool "RSA2048 setting"

config RSA1024
	bool "RSA1024 setting"
endchoice

config SHUTDOWN
	bool "Send shutdown signal to micom"
	default n
	depends on EXECUTE_AUTHULD=y 
	help
		decide whether send "shutdown" to micom or not

config MICOM_TTY_PATH
	string "tty device name(full path) for micom communication (ex: /dev/ttyS1)"
	default "/dev/ttyS1"
	depends on EXECUTE_AUTHULD=y 
	help
		device path setting for micom communication

config AUTHULD_PATH
	string "Path to authuld file"
	default "/bin/authuld" 
	depends on EXECUTE_AUTHULD=y 
	help
		Allows to redirect authuld files into specified location.

config TIMEOUT_ACK_AUTHULD
	int "Timout of authuld ack(minute)"
	default 3
	depends on EXECUTE_AUTHULD=y
	help
		if kernel do not get ACK from authuld, System will be down.
config BOOTLOADER_ERASE
	bool "erase bootloader in memory"
	default n
	help
		During kernel initialization, onboot will be erased in memory
config BOOTLOADER_SIZE
	hex "bootloader size"
	default 0x20000
	depends on BOOTLOADER_ERASE
	help
		erase bootloader size
endmenu # end of "CI+ Option" menu
```

## arch/arm/mach-sdp/Kconfig
```kconfig
######################################################################
#
# 	Kconfig for machine about Samsung DTV Platform 
# 	
# 	created seungjun.heo@samsung.com
#
######################################################################
#
# Dec,16,2013	created by seungjun.heo
# 

if ARCH_SDP

config MACH_SDP_DT
	bool "Samsung DTV Machine using device tree"
	select USE_OF
	select ARM_GIC
	select GIC_NON_BANKED
	select USB_ARCH_HAS_EHCI if USB_SUPPORT
	select USB_ARCH_HAS_OHCI if USB_SUPPORT
	select USB_ARCH_HAS_XHCI if USB_SUPPORT
	select PINCTRL
	select PINCTRL_SDP
	select ARCH_REQUIRE_GPIOLIB
	select ARCH_DMA_ADDR_T_64BIT if ARM_LPAE
	select ARM_HAS_SG_CHAIN
	select CLKSRC_OF
 	help
	  Say 'Y' here if you want your kernel to support the
	  Samsung DTV using flattened device tree.

choice
	prompt "select SDP chip name"
	default ARCH_SDP1304

config ARCH_SDP1106
	bool "SDP1106 : Echo-P"

config ARCH_SDP1202
	bool "SDP1202 : Fox-P"

config ARCH_SDP1207
	bool "SDP1207 : Fox-B"

config ARCH_SDP1304
	bool "SDP1304 : Golf-P"

config ARCH_SDP1404
	bool "SDP1404 : Hawk-P"

config ARCH_SDP1406
	bool "SDP1406 : Hawk-M"

config ARCH_SDP1412
	bool "SDP1412 : Hawk-A"

endchoice

config ARCH_SDP_BL
	bool "SDP bigLittle cluster management"
	depends on MCPM
	select ARM_CCI
	help
	  Support for CPU and cluster power management on SDP bigLittle.

#config ARM_TRUSTZONE
#	bool "Support TrustZone-enabled Trusted Execution Environment"
#	default n
#	help
#	  Select if you want a kernel to be executed at non-secure world.
#	  This option should be used with related secure bootloader and
#	  TrustZone software.
#
#	  If you don't know about TrustZone, say 'N'.



menu "Samsung SDP Implementation"

config 	SDP_TIMER
	bool
	default n
	select GENERIC_TIME
	select GENERIC_CLOCKEVENTS

config SERIAL_SDP
	tristate "UART Controller support"
	default y
	depends on ARCH_SDP
	select SERIAL_CORE

config SERIAL_SDP_CONSOLE
	bool "Support Serial Console"
	default y
	depends on SERIAL_SDP=y
	select SERIAL_CORE_CONSOLE

config SDP_MAC
        depends on ARCH_SDP
        tristate "Ethernet MAC Driver"
        select NET
        select INET
        select NETDEVICES
        select MII
        select ETHERNET
        select PHYLIB

config SDP_MAC_DEBUG
		depends on SDP_MAC
		bool "Print Debug Msg for SDP MAC"

if SDP_MAC

# Use Normal Descriptor
config SDP_MAC_NORMAL_DESC
		default n
		bool	"MAC Use Normal Descriptor"

choice
        prompt "How to set MAC Address?"
        default MAC_SET_RAMDOM

config MAC_SET_BY_USER
        depends on SDP_MAC
        bool    "MAC set mac address by user"

config MAC_SET_RANDOM
        depends on SDP_MAC
        bool    "Generate software assigned random ethernet addr"


endchoice


if MAC_SET_BY_USER

config MAC_FRONT_4BYTE
        depends on MAC_SET_BY_USER
        hex     "MAC Mac address front 4 byte"
        default 0xFFFFFFFF

config MAC_END_2BYTE
        depends on MAC_SET_BY_USER
        hex     "MAC Mac address end 2 byte"
        default 0xFFFF
endif # MAC_SET_BY_USER

endif # SDP_MAC

config SDP_MMC
	depends on ARCH_SDP
	tristate "SDP MMC/SD Controller"
	default y
	select MMC

config SDP_MMC_64BIT_ADDR
	bool "Using IDMAC 64bit address"
	default y if (ARCH_SDP1404 || ARCH_SDP1406)
	depends on SDP_MMC

config SDP_MMC_DMA
	bool "Using Internal DMA Controler"
	default y
	depends on SDP_MMC


#config SDP_MMC_USE_AUTO_STOP_CMD
#	bool "Use to send H/W auto stop cmd"
#	default y
#	depends on SDP_MMC

config SDP_MMC_USE_PRE_DEFINED_XFER
	bool "Use Pre-defined data xfer(CMD23)"
	default n
	depends on SDP_MMC
	help
	  No: Open-ended xfer, Yes: Pre-defined xfer



config SDP_SPI
	tristate "SDP SPI Master Controller Driver"
	default n
	depends on ARCH_SDP
	select SPI
	select SPI_MASTER
	help
	  SDP SPI Master Controller Driver.

config SDP_SPI_NUM_OF_CS
	int "Number of chip select."
	default 1
	depends on SDP_SPI
	help
	  Default CS is 1, but if you used the GPIO CS, CS can be larger than 1.

config SDP_SPIDEV
	tristate "User Level SPI Device Driver for SDP SPI"
	depends on SDP_SPI

config SDP_SPI_DEBUG
	bool "Print Debug Msg for SDP SPI"
	depends on SDP_SPI



config SDP_DMA330
	tristate "SDP DMA330 Controller Driver"
	default n
	depends on (ARCH_SDP1202 || ARCH_SDP1207 || ARCH_SDP1302 || ARCH_SDP)
	select DMADEVICES
	select DMA_ENGINE

config SDP_DMA330_DEBUG
	bool "Print Debug Msg for SDP DMA330"
	depends on SDP_DMA330

config SDP_GADMA
	tristate "SDP GADMA Controller Driver"
	default n
	depends on (ARCH_SDP)
	select DMADEVICES
	select DMA_ENGINE


config SDP_GDMA
	tristate "SDP General DMA Controller Driver"
	default n
	depends on (ARCH_SDP1207 || ARCH_SDP1307 || ARCH_SDP)
	select DMADEVICES
	select DMA_ENGINE


config SDP_DMADEV
	tristate "SDP DMADEV : Using user mode DMA"
	default n
	depends on DMA_ENGINE

config SDP_DMATEST
	tristate "SDP DMATEST : Simple DMA test client."
	default n
	depends on DMA_ENGINE


config SDP_UNZIP
	bool "SDP GZIP decompressor for Squashfs"
	default y

config SDP_THERMAL
	depends on ARCH_SDP && CPU_FREQ
	bool "Thermal Management"
	default y

config SDP_TEMPSENSOR
	depends on ARCH_SDP
	bool "Simple temperature sensor"
	default y

config SDP_HW_CLOCK
	depends on ARCH_SDP
	bool "HW clock, which ticks from power on of the board"
	default n
	help
		Usually HW clock is enabled by onboot, so kernel can access
		it by default.  But enabling this configuration makes HW
		physicall address being mapped to virtual address space
		on very early kernel setup.

config SDP_MISC_PM
	depends on ARCH_SDP
	tristate "SDP MISC (wifi, st, bt) device power control Driver"
	default y

endmenu #Samsung SDP implements 

#menu "Select ARM Errata Patch"
#
#endmenu

endif # ARCH_SDP	
```
